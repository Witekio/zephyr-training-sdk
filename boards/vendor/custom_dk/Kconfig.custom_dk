## boards/vendor/custom_dk/Kconfig.custom_dk
```kconfig
# Copyright (c) 2023 STMicroelectronics
# SPDX-License-Identifier: Apache-2.0

config BOARD_CUSTOM_DK
	select SOC_STM32H573XX
```

## boards/vendor/custom_dk/board.yml
```yaml
board:
  name: custom_dk
  full_name: STM32H573I-DK Discovery
  vendor: st
  socs:
    - name: stm32h573xx
      variants:
        - name: ext_flash_app
        - name: ns
```

## lib/custom_lib/Kconfig
```kconfig
config CUSTOM_LIB
    bool "Enable custom library"
    help
        Enable the custom lib.
```

## west.yml
```yaml
manifest:
  remotes:
  - name: zephyrrtos
    url-base: https://github.com/zephyrproject-rtos
  - name: Witekio
    url-base: git@github.com:Witekio
  projects:
  - name: zephyr
    remote: zephyrrtos
    revision: main
    import:
      name-allowlist:
        - cmsis_6
        - hal_stm32
  - name: zephyr-training-sdk-cjson
    remote: Witekio
    revision: main
    path: modules/lib/cjson
    submodules: true
```
